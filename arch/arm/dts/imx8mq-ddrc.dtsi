/*
 * Include file to switch board DTS form using hardcoded memory node
 * to dynamic memory size detection based on DDR controller settings
 */

/ {
	peripherals@0 {
		ddrc@3d400000 {
			compatible = "fsl,imx8mq-ddrc";
			reg = <0x3d400000 0x400000>;
		};
	};
};

