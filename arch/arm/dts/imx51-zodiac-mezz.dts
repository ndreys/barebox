/*
 * Copyright 2011 Freescale Semiconductor, Inc.
 * Copyright 2011 Linaro Ltd.
 *
 * The code contained herein is licensed under the GNU General Public
 * License. You may obtain a copy of the GNU General Public License
 * Version 2 or later at the following locations:
 *
 * http://www.opensource.org/licenses/gpl-license.html
 * http://www.gnu.org/copyleft/gpl.html
 */

#include <arm/imx51-zodiac-mezz.dts>

/ {
	chosen {
		stdout-path = &uart1;

		environment@0 {
			compatible = "barebox,environment";
			/*device-path = &environment_at45;*/
		};
	};
};

&iim {
	barebox,provide-mac-address = <&fec 1 9>;
};
