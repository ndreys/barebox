/*
 * The code contained herein is licensed under the GNU General Public
 * License. You may obtain a copy of the GNU General Public License
 * Version 2 or later at the following locations:
 *
 * http://www.opensource.org/licenses/gpl-license.html
 * http://www.gnu.org/copyleft/gpl.html
 */

#include <arm/imx7d-sdb.dts>
#include "imx7s.dtsi"

/ {
	chosen {
		stdout-path = &uart1;
	};

	memory {
		device_type = "memory";
		reg = <0x80000000 0x40000000>;
	};
};
