// SPDX-License-Identifier: (GPL-2.0 OR MIT)

/*
 * Copyright (C) 2018 Zodiac Inflight Innovations
 */


#include <arm/imx51-zii-scu3-esb.dts>

/ {
	chosen {
		environment@0 {
			compatible = "barebox,environment";
			/*device-path = &environment_at45;*/
		};
	};
};

&iim {
	barebox,provide-mac-address = <&fec 1 9>;
};
