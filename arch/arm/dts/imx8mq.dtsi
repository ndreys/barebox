

&clk {
	assigned-clocks = <&clk IMX8MQ_CLK_ENET_AXI_SRC>,
			  <&clk IMX8MQ_CLK_ENET_TIMER_SRC>,
			  <&clk IMX8MQ_CLK_ENET_REF_SRC>,
			  <&clk IMX8MQ_CLK_ENET_TIMER_DIV>;

	assigned-clock-parents =  <&clk IMX8MQ_SYS1_PLL_266M>,
				  <&clk IMX8MQ_SYS2_PLL_100M>,
				  <&clk IMX8MQ_SYS2_PLL_125M>,
				  <0>;

	assigned-clock-rates = <266000000>,
			       <0>,
			       <125000000>,
			       <25000000>;
};