## arch/arm/configs/vf610_ocram_defconfig
```kconfig
CONFIG_TEXT_BASE=0x3f000000
CONFIG_BUILTIN_DTB=y
CONFIG_BUILTIN_DTB_NAME="vf610-ocram"
CONFIG_ARCH_IMX=y
CONFIG_BAREBOX_MAX_IMAGE_SIZE=0x6e000
CONFIG_MACH_VF610_OCRAM=y
CONFIG_THUMB2_BAREBOX=y
CONFIG_ARM_OPTIMZED_STRING_FUNCTIONS=y
CONFIG_ARM_UNWIND=y
CONFIG_ARM_SEMIHOSTING=y
CONFIG_MMU=y
CONFIG_MEMORY_LAYOUT_FIXED=y
CONFIG_STACK_BASE=0x3f07e000
CONFIG_STACK_SIZE=0x1fb8
CONFIG_MALLOC_BASE=0x3f400000
CONFIG_MALLOC_SIZE=0x80000
CONFIG_BSS_SIZE=0x3000
CONFIG_MALLOC_TLSF=y
CONFIG_KALLSYMS=y
CONFIG_HUSH_FANCY_PROMPT=y
CONFIG_CMDLINE_EDITING=y
CONFIG_AUTO_COMPLETE=y
CONFIG_CONSOLE_ACTIVATE_ALL=y
CONFIG_DEFAULT_COMPRESSION_NONE=y
CONFIG_DEFAULT_ENVIRONMENT_GENERIC_NEW=y
CONFIG_CMD_DMESG=y
CONFIG_LONGHELP=y
CONFIG_CMD_IOMEM=y
CONFIG_CMD_IMD=y
CONFIG_CMD_MEMINFO=y
CONFIG_CMD_ARM_MMUINFO=y
# CONFIG_CMD_BOOTM is not set
# CONFIG_CMD_BOOTU is not set
CONFIG_CMD_RESET=y
CONFIG_CMD_PARTITION=y
CONFIG_CMD_EXPORT=y
CONFIG_CMD_PRINTENV=y
CONFIG_CMD_MAGICVAR=y
CONFIG_CMD_MAGICVAR_HELP=y
CONFIG_CMD_FILETYPE=y
CONFIG_CMD_LN=y
CONFIG_CMD_MD5SUM=y
CONFIG_CMD_UNCOMPRESS=y
CONFIG_CMD_LET=y
CONFIG_CMD_MSLEEP=y
CONFIG_CMD_READF=y
CONFIG_CMD_SLEEP=y
CONFIG_CMD_ECHO_E=y
CONFIG_CMD_EDIT=y
CONFIG_CMD_READLINE=y
CONFIG_CMD_TIMEOUT=y
CONFIG_CMD_CRC=y
CONFIG_CMD_CRC_CMP=y
CONFIG_CMD_MEMTEST=y
CONFIG_CMD_MM=y
CONFIG_OFDEVICE=y
# CONFIG_DRIVER_SERIAL_IMX is not set
# CONFIG_SPI is not set
CONFIG_I2C=y
CONFIG_I2C_IMX=y
CONFIG_EEPROM_AT24=y
CONFIG_KEYBOARD_GPIO=y
CONFIG_ZLIB=y
CONFIG_LZO_DECOMPRESS=y
```

## arch/arm/configs/zii_imx6q_sram_defconfig
```kconfig
CONFIG_ARCH_IMX=y
CONFIG_BAREBOX_MAX_IMAGE_SIZE=0x1c000
CONFIG_MACH_ZII_IMX6_SRAM=y
CONFIG_THUMB2_BAREBOX=y
CONFIG_ARM_OPTIMZED_STRING_FUNCTIONS=y
CONFIG_ARM_UNWIND=y
# CONFIG_LOCALVERSION_AUTO is not set
# CONFIG_BANNER is not set
# CONFIG_MEMINFO is not set
CONFIG_BAREBOX_MAX_BARE_INIT_SIZE=0x5000
CONFIG_STACK_SIZE=0x2000
CONFIG_MALLOC_SIZE=0x1e000
CONFIG_MALLOC_TLSF=y
CONFIG_KALLSYMS=y
CONFIG_PANIC_HANG=y
CONFIG_SHELL_SIMPLE=y
CONFIG_CMDLINE_EDITING=y
CONFIG_AUTO_COMPLETE=y
# CONFIG_ERRNO_MESSAGES is not set
# CONFIG_TIMESTAMP is not set
CONFIG_CONSOLE_SIMPLE=y
# CONFIG_DEFAULT_ENVIRONMENT is not set
CONFIG_POLLER=y
CONFIG_DEBUG_INFO=y
# CONFIG_CMD_ARM_CPUINFO is not set
# CONFIG_CMD_DRVINFO is not set
CONFIG_LONGHELP=y
CONFIG_CMD_IOMEM=y
CONFIG_CMD_MEMINFO=y
CONFIG_CMD_ARM_MMUINFO=y
# CONFIG_CMD_BOOTM is not set
# CONFIG_CMD_BOOTU is not set
# CONFIG_CMD_MOUNT is not set
# CONFIG_CMD_UMOUNT is not set
# CONFIG_CMD_CAT is not set
# CONFIG_CMD_CP is not set
# CONFIG_CMD_MKDIR is not set
# CONFIG_CMD_PWD is not set
# CONFIG_CMD_RM is not set
# CONFIG_CMD_RMDIR is not set
# CONFIG_CMD_FALSE is not set
# CONFIG_CMD_TRUE is not set
# CONFIG_CMD_CLEAR is not set
# CONFIG_CMD_ECHO is not set
CONFIG_CMD_MEMTEST=y
CONFIG_CMD_MM=y
CONFIG_CMD_MMDC=y
CONFIG_OFDEVICE=y
# CONFIG_SPI is not set
```

## arch/arm/configs/zii_v7_defconfig
```kconfig
CONFIG_ARCH_IMX=y
CONFIG_CACHE_L2X0=y
CONFIG_IMX_MULTI_BOARDS=y
CONFIG_MACH_ZII_RDU1=y
CONFIG_MACH_ZII_RDU2=y
CONFIG_MACH_FREESCALE_MX7_SABRESD=y
CONFIG_IMX_IIM=y
CONFIG_IMX_IIM_FUSE_BLOW=y
CONFIG_THUMB2_BAREBOX=y
CONFIG_ARM_OPTIMZED_STRING_FUNCTIONS=y
CONFIG_ARM_UNWIND=y
CONFIG_MMU=y
CONFIG_MALLOC_SIZE=0x0
CONFIG_MALLOC_TLSF=y
CONFIG_KALLSYMS=y
CONFIG_RELOCATABLE=y
CONFIG_HUSH_FANCY_PROMPT=y
CONFIG_AUTO_COMPLETE=y
CONFIG_MENU=y
CONFIG_BOOTM_VERBOSE=y
CONFIG_BOOTM_INITRD=y
CONFIG_BOOTM_OFTREE=y
CONFIG_BLSPEC=y
CONFIG_CONSOLE_ACTIVATE_NONE=y
CONFIG_CONSOLE_ALLOW_COLOR=y
CONFIG_CONSOLE_RATP=y
CONFIG_RATP_CMD_I2C=y
CONFIG_RATP_CMD_GPIO=y
CONFIG_PARTITION_DISK_EFI=y
CONFIG_DEFAULT_ENVIRONMENT_GENERIC_NEW=y
CONFIG_RESET_SOURCE=y
CONFIG_CMD_DMESG=y
CONFIG_LONGHELP=y
CONFIG_CMD_IOMEM=y
CONFIG_CMD_IMD=y
CONFIG_CMD_MEMINFO=y
CONFIG_CMD_ARM_MMUINFO=y
CONFIG_CMD_REGULATOR=y
CONFIG_CMD_MMC_EXTCSD=y
# CONFIG_CMD_BOOTU is not set
CONFIG_CMD_GO=y
CONFIG_CMD_LOADY=y
CONFIG_CMD_RESET=y
CONFIG_CMD_UIMAGE=y
CONFIG_CMD_PARTITION=y
CONFIG_CMD_EXPORT=y
CONFIG_CMD_LOADENV=y
CONFIG_CMD_PRINTENV=y
CONFIG_CMD_MAGICVAR=y
CONFIG_CMD_MAGICVAR_HELP=y
CONFIG_CMD_SAVEENV=y
CONFIG_CMD_FILETYPE=y
CONFIG_CMD_LN=y
CONFIG_CMD_MD5SUM=y
CONFIG_CMD_UNCOMPRESS=y
CONFIG_CMD_LET=y
CONFIG_CMD_MSLEEP=y
CONFIG_CMD_READF=y
CONFIG_CMD_SLEEP=y
CONFIG_CMD_DHCP=y
CONFIG_CMD_MIITOOL=y
CONFIG_CMD_PING=y
CONFIG_CMD_TFTP=y
CONFIG_CMD_ECHO_E=y
CONFIG_CMD_EDIT=y
CONFIG_CMD_MENU=y
CONFIG_CMD_MENU_MANAGEMENT=y
CONFIG_CMD_MENUTREE=y
CONFIG_CMD_SPLASH=y
CONFIG_CMD_FBTEST=y
CONFIG_CMD_READLINE=y
CONFIG_CMD_TIMEOUT=y
CONFIG_CMD_CRC=y
CONFIG_CMD_CRC_CMP=y
CONFIG_CMD_MEMTEST=y
CONFIG_CMD_MM=y
CONFIG_CMD_CLK=y
CONFIG_CMD_DETECT=y
CONFIG_CMD_FLASH=y
CONFIG_CMD_GPIO=y
CONFIG_CMD_I2C=y
CONFIG_CMD_LED=y
CONFIG_CMD_SPI=y
CONFIG_CMD_LED_TRIGGER=y
CONFIG_CMD_USBGADGET=y
CONFIG_CMD_WD=y
CONFIG_CMD_BAREBOX_UPDATE=y
CONFIG_CMD_OF_NODE=y
CONFIG_CMD_OF_PROPERTY=y
CONFIG_CMD_OFTREE=y
CONFIG_CMD_TIME=y
CONFIG_NET=y
CONFIG_NET_NETCONSOLE=y
CONFIG_NET_RESOLV=y
CONFIG_OF_BAREBOX_DRIVERS=y
CONFIG_AIODEV=y
CONFIG_IMX_THERMAL=y
CONFIG_LM75=y
CONFIG_MC13XXX_ADC=y
CONFIG_RAVE_SP_AIODEV=y
CONFIG_SERIAL_DEV_BUS=y
CONFIG_DRIVER_NET_E1000=y
CONFIG_DRIVER_NET_FEC_IMX=y
CONFIG_AT803X_PHY=y
CONFIG_LXT_PHY=y
CONFIG_MICREL_PHY=y
CONFIG_NET_DSA_MV88E6XXX=y
CONFIG_MDIO_BITBANG=y
CONFIG_MDIO_GPIO=y
CONFIG_NET_USB=y
CONFIG_NET_USB_ASIX=y
CONFIG_NET_USB_SMSC95XX=y
CONFIG_I2C=y
CONFIG_I2C_IMX=y
CONFIG_MTD=y
CONFIG_MTD_RAW_DEVICE=y
CONFIG_MTD_DATAFLASH=y
CONFIG_MTD_M25P80=y
CONFIG_MTD_SST25L=y
CONFIG_DISK_AHCI=y
CONFIG_DISK_AHCI_IMX=y
CONFIG_DISK_INTF_PLATFORM_IDE=y
CONFIG_DISK_PATA_IMX=y
CONFIG_USB_HOST=y
CONFIG_USB_IMX_CHIPIDEA=y
CONFIG_USB_EHCI=y
CONFIG_USB_ULPI=y
CONFIG_USB_STORAGE=y
CONFIG_USB_GADGET=y
# CONFIG_USB_GADGET_AUTOSTART is not set
CONFIG_USB_GADGET_DFU=y
CONFIG_USB_GADGET_SERIAL=y
CONFIG_USB_GADGET_FASTBOOT=y
CONFIG_USB_GADGET_FASTBOOT_SPARSE=y
CONFIG_USB_GADGET_FASTBOOT_BUF=y
CONFIG_VIDEO=y
CONFIG_FRAMEBUFFER_CONSOLE=y
CONFIG_DRIVER_VIDEO_IMX_IPUV3=y
CONFIG_DRIVER_VIDEO_IMX_IPUV3_LVDS=y
CONFIG_DRIVER_VIDEO_IMX_IPUV3_PARALLEL=y
CONFIG_DRIVER_VIDEO_SIMPLEFB=y
CONFIG_DRIVER_VIDEO_EDID=y
CONFIG_DRIVER_VIDEO_BACKLIGHT=y
CONFIG_DRIVER_VIDEO_BACKLIGHT_PWM=y
CONFIG_BACKLIGHT_RAVE_SP=y
CONFIG_DRIVER_VIDEO_TC358767=y
CONFIG_DRIVER_VIDEO_SIMPLE_PANEL=y
CONFIG_MCI=y
CONFIG_MCI_MMC_BOOT_PARTITIONS=y
CONFIG_MCI_IMX_ESDHC=y
CONFIG_MFD_MC34704=y
CONFIG_MFD_MC9SDZ60=y
CONFIG_MFD_STMPE=y
CONFIG_RAVE_SP_CORE=y
CONFIG_LED=y
CONFIG_LED_GPIO=y
CONFIG_LED_TRIGGERS=y
CONFIG_EEPROM_AT25=y
CONFIG_EEPROM_AT24=y
CONFIG_KEYBOARD_GPIO=y
CONFIG_WATCHDOG=y
CONFIG_WATCHDOG_IMX=y
CONFIG_RAVE_SP_WATCHDOG=y
CONFIG_PWM=y
CONFIG_PWM_IMX=y
CONFIG_MXS_APBH_DMA=y
CONFIG_GPIO_STMPE=y
CONFIG_IMX_OCOTP_WRITE=y
CONFIG_RAVE_SP_EEPROM=y
CONFIG_REGULATOR=y
CONFIG_REGULATOR_FIXED=y
CONFIG_REGULATOR_ANATOP=y
CONFIG_RESET_CONTROLLER=y
CONFIG_RESET_IMX7=y
CONFIG_PCI_IMX6=y
CONFIG_RTC_CLASS=y
CONFIG_RTC_DRV_DS1307=y
CONFIG_GENERIC_PHY=y
CONFIG_USB_NOP_XCEIV=y
CONFIG_FS_EXT4=y
CONFIG_FS_TFTP=y
CONFIG_FS_NFS=y
CONFIG_FS_FAT=y
CONFIG_FS_FAT_WRITE=y
CONFIG_FS_FAT_LFN=y
CONFIG_FS_RATP=y
CONFIG_LZO_DECOMPRESS=y
CONFIG_BMP=y
CONFIG_PNG=y
```

## drivers/aiodev/Kconfig
```kconfig
#
# Misc strange devices
#
menuconfig AIODEV
	bool "Analog I/O drivers"

if AIODEV

config IMX_THERMAL
       tristate "Temperature sensor driver for Freescale i.MX SoCs"
       depends on ARCH_IMX6
       select MFD_SYSCON
       help
         Support for Temperature Monitor (TEMPMON) found on Freescale
         i.MX SoCs.

config LM75
	tristate "LM75 driver"
	depends on I2C
	help
	  Support for LM75 and similar devices

config RAVE_SP_AIODEV
	tristate "Driver for sensors present in RAVE SP"
	depends on RAVE_SP_CORE
	help
	  Support for accessing sensor information provided by RAVE SP
	  devices
endif
```
